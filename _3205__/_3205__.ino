#include <Rtc_Pcf8563.h>
#include "U8glib.h"


Rtc_Pcf8563 rtc;

#include "Wire.h"


//-------字体设置，大、中、小
#define setFont_L u8g.setFont(u8g_font_7x13)
#define setFont_M u8g.setFont(u8g_font_fixed_v0r)
#define setFont_S u8g.setFont(u8g_font_fixed_v0r)
#define setFont_A u8g.setFont(u8g_font_9x18Br)
#define setFont_SS u8g.setFont(u8g_font_fub25n)
/*
  字体由小到大
  font:
  u8g_font_chikitar
  u8g_font_fixed_v0r
  u8g_font_7x13
  u8g_font_9x18Br
  u8g_font_courB14r
  u8g_font_osb21
  u8g_font_fub25n
  u8g_font_courB24n
*/
//屏幕类型--------
U8GLIB_SSD1306_128X64 u8g(U8G_I2C_OPT_NONE);

#define init_draw 10  //主界面刷新时间
unsigned long timer_draw, timer;
int pkj = 0;
String dateStr, ret;
const unsigned char a[] U8G_PROGMEM =
{
  /*--  文字:  三  --*/
  /*--  楷体_GB231212;  此字体下对应的点阵为：宽x高=16x16   --*/
  0x00, 0x00, 0x00, 0x00, 0x00, 0x00, 0x00, 0x00, 0x10, 0x04, 0x44, 0x10, 0x80, 0x00, 0x00, 0x00,
  0x00, 0x00, 0x00, 0x00, 0x00, 0x00, 0x00, 0x00, 0x10, 0x04, 0x88, 0x10, 0x80, 0x00, 0xF8, 0x0F,

  /*--  文字:  2  --*/
  /*--  楷体_GB231212;  此字体下对应的点阵为：宽x高=16x16   --*/
  0xFE, 0x3F, 0x00, 0x00, 0x00, 0x00, 0x00, 0x00, 0xFF, 0x7F, 0x88, 0x08, 0x84, 0x10, 0x08, 0x08,
  0x00, 0x00, 0x3C, 0x00, 0x18, 0x00, 0x7E, 0x00, 0x10, 0x04, 0x00, 0x04, 0x84, 0x10, 0x08, 0x08,

  /*--  文字:  0  --*/
  /*--  楷体_GB231212;  此字体下对应的点阵为：宽x高=16x16   --*/
  0x00, 0x00, 0x42, 0x00, 0x24, 0x00, 0x02, 0x00, 0x00, 0x00, 0xFF, 0x7F, 0x84, 0x10, 0x08, 0x08,
  0x00, 0x00, 0x42, 0x00, 0x42, 0x00, 0x02, 0x00, 0xFE, 0x7F, 0x10, 0x04, 0x84, 0x10, 0x08, 0x08,

  /*--  文字:  5  --*/
  /*--  楷体_GB231212;  此字体下对应的点阵为：宽x高=16x16   --*/
  0x00, 0x00, 0x42, 0x00, 0x42, 0x00, 0x02, 0x00, 0x02, 0x40, 0x88, 0x08, 0xFC, 0x1F, 0xF8, 0x0F,
  0xFC, 0x1F, 0x40, 0x00, 0x42, 0x00, 0x1E, 0x00, 0x81, 0x20, 0xF4, 0x17, 0x80, 0x10, 0x00, 0x00,

  /*--  文字:  荣  --*/
  /*--  楷体_GB231212;  此字体下对应的点阵为：宽x高=16x16   --*/
  0x00, 0x00, 0x20, 0x00, 0x42, 0x00, 0x22, 0x00, 0x80, 0x00, 0x03, 0x60, 0x80, 0x00, 0x00, 0x00,
  0x00, 0x00, 0x10, 0x00, 0x42, 0x00, 0x40, 0x00, 0xFE, 0x3F, 0xF8, 0x0F, 0x80, 0x00, 0x3E, 0x3E,

  /*--  文字:  誉  --*/
  /*--  楷体_GB231212;  此字体下对应的点阵为：宽x高=16x16   --*/
  0x00, 0x00, 0x08, 0x00, 0x42, 0x00, 0x40, 0x00, 0xC0, 0x01, 0x00, 0x00, 0x82, 0x20, 0x22, 0x22,
  0x00, 0x00, 0x04, 0x00, 0x42, 0x00, 0x42, 0x00, 0xA0, 0x02, 0xF8, 0x0F, 0x82, 0x20, 0x22, 0x22,

  /*--  文字:  出  --*/
  /*--  楷体_GB231212;  此字体下对应的点阵为：宽x高=16x16   --*/
  0x00, 0x00, 0x42, 0x00, 0x24, 0x00, 0x22, 0x00, 0x90, 0x04, 0x00, 0x00, 0x82, 0x20, 0x22, 0x22,
  0xFF, 0x7F, 0x7E, 0x00, 0x18, 0x00, 0x1C, 0x00, 0x8C, 0x18, 0xF8, 0x0F, 0x82, 0x20, 0x22, 0x22,

  /*--  文字:  品  --*/
  /*--  楷体_GB231212;  此字体下对应的点阵为：宽x高=16x16   --*/
  0x00, 0x00, 0x00, 0x00, 0x00, 0x00, 0x00, 0x00, 0x83, 0x60, 0x08, 0x08, 0xFE, 0x3F, 0x3E, 0x3E,
  0x00, 0x00, 0x00, 0x00, 0x00, 0x00, 0x00, 0x00, 0x80, 0x00, 0xF8, 0x0F, 0x00, 0x20, 0x22, 0x22,



};
const unsigned char x[] U8G_PROGMEM =
{
  /*--  调入了一幅图像：C:\Users\lenovo\Desktop\zz.bmp  --*/
  /*--  宽度x高度=116x63  --*/
  /*--  宽度不是8的倍数，现调整为：宽度x高度=120x63  --*/
  0x00, 0x00, 0x00, 0x00, 0x00, 0xF0, 0xFF, 0xFF, 0x00, 0x00, 0x00, 0x00, 0x00, 0x00, 0x00, 0x00,
  0x00, 0x00, 0x00, 0x00, 0x7E, 0x00, 0x80, 0x03, 0x00, 0x00, 0x00, 0x00, 0x00, 0x00, 0x00, 0x00,
  0x00, 0x00, 0x00, 0x0F, 0x00, 0x00, 0x0E, 0x00, 0x00, 0x00, 0x00, 0x00, 0x00, 0x00, 0x00, 0x00,
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  0x00,
};

void setup() {
  // Start the I2C interface
  b();//开始画面X,Y
  Serial.begin(9600);
  setRtcTime(16, 12, 12, 5, 9, 5, 0 );
  timer = millis();
}
//------开机画面----------
void b()
{
  //u8g.setRot180();//屏幕旋转x度
  u8g.firstPage();
  do
  {
    u8g.drawXBMP( 0 , 20, 128, 16, a); //调用上面的图像代码
    //(x1,y1,w,h,u8g_logo_bits)图片显示范围左上角坐标x1,y1 图像宽度w高度h 图像
  } while ( u8g.nextPage() );
  delay(3000);//延时2秒到下一个画面
  u8g.firstPage();
  do
  {
    u8g.drawXBMP( 0 , 0, 116, 63, x);
    //(x1,y1,w,h,u8g_logo_bits)图片显示范围左上角坐标x1,y1 图像宽度w高度h 图像
  } while ( u8g.nextPage() );
  delay(3000);//延时2秒到下一个画面
  u8g.firstPage();
  do {
    u8g.drawFrame(5, 15, 20, 20); //矩形X,Y,W,H
    u8g.drawRFrame(30, 15, 20, 20, 5); //四边斜角型X,Y,W,H,R=四边的角
    u8g.drawBox(55, 15, 20, 20); //x, y, w, h实心矩形
    u8g.drawRBox(80, 15, 20, 20, 5); //x, y, w, h,r斜角实心型
    u8g.drawCircle(15, 50, 10, 30); // x0, y0, rad=圆的大小, opt缺口的方向

  }
  while ( u8g.nextPage() );
  delay(1000);
  u8g.firstPage();
  do  {
    u8g.drawCircle(15, 50, 10, 30); // x0, y0, rad=圆的大小, opt缺口的方向
    u8g.drawDisc(115, 25, 10, 30); //x0, y0, rad, opt实心圆
    u8g.drawEllipse(40, 50, 10, 5); //x0, y0, rad, opt椭圆形
    u8g.drawEllipse(40, 50, 5, 10); //x0, y0, rad, opt椭圆形
    u8g.drawFilledEllipse(65, 50, 5, 10); //x0, y0, rad, opt 实心椭圆形
    u8g.drawFilledEllipse(65, 50, 10, 5); //x0, y0, rad, opt 实心椭圆形
    u8g.drawTriangle(90, 55, 100, 45, 80, 45); //x0, y0, x1, y1, x2, y2三角关系
  } while ( u8g.nextPage() );
  delay(1000);
}

//======定义的显示模式======
void loop() {
  ret = getRtcTimeString();

  if (millis() - timer_draw > init_draw)
  {
    pkj -= 4;
    u8g.firstPage();
    do {
      draw();
    }
    while ( u8g.nextPage() );
    timer_draw = millis();
  }
}
void draw()
{
  setFont_S;
  u8g.setPrintPos(0, 20);
  u8g.print(rtc.formatDate(RTCC_DATE_US));
  u8g.print(" ");
  setFont_A;

  switch (rtc.getWeekday()) {
    case 1:
      u8g.print("*_* Mon");
      break;
    case 2:
      u8g.print("+_+ Tue");
      break;
    case 3:
      u8g.print("#_# Wed");
      break;
    case 4:
      u8g.print("o_o Thu");
      break;
    case 5:
      u8g.print("Fri ");
      if (rtc.getSecond() % 8 == 0)
        u8g.print("~o~ ");
      else if (rtc.getSecond() % 8 == 1)
        u8g.drawDisc(113, 13, 5, 1);
      else if (rtc.getSecond() % 8 == 2)
        u8g.print("@u@ ");
      else if (rtc.getSecond() % 8 == 3)
        u8g.drawDisc(113, 13, 5, 3);
      else if (rtc.getSecond() % 8 == 4)
        u8g.print("#_# ");
      else if (rtc.getSecond() % 8 == 5)
        u8g.drawDisc(113, 13, 5, 7);
      else if (rtc.getSecond() % 8 == 6)
      { u8g.drawFrame(99, 5, 29, 20);
        u8g.drawTriangle(108, 11, 113, 18, 118, 11);
      }
      else u8g.drawDisc(113, 13, 5);
      break;
    case 6:
      u8g.print("@o@ Sat");
      break;
    case 7:
      u8g.print("^u^ Sun");
      break;
  }
  if (rtc.getSecond() % 2 == 0)
  { u8g.drawLine(32, 54, 64, 16);
    u8g.drawLine(64, 16, 96, 54);
    u8g.drawLine(0, 54, 16, 35);
    u8g.drawLine(16, 35, 32, 54);
    u8g.drawLine(96, 54, 112, 35);
    u8g.drawLine(112, 35, 128, 54);
  }
  else
  {
    u8g.print("   ");
  }
  //u8g.drawDisc(113,13,5);
  /*drawDisc (x,y,rad,opt缺角图)
    opt=1,2,4,8分别为 右上左上左下右下
    opt=3,6,9,12分别为 上半左半右半下半
    opt=5，10分别为 左对角线 右对角线
    opt=7 11 13 14 缺右下角 缺左下角 缺左上角 缺右上角
    opt=15 整圆，和（x,y,rad）效果一样
    opt=16 空
    16为一周期opt（x）=opt（x+n*16）（n为正整数）t*/
  setFont_L;
  u8g.setPrintPos(pkj, 64);

  u8g.print("Like a rolling stone!");
  u8g.setPrintPos(pkj, 58);
  setFont_SS;
  u8g.setPrintPos(0, 50);
  if (rtc.getHour() < 10)
  {
    u8g.print("0");
    u8g.print(rtc.getHour());
  }
  else
    u8g.print(rtc.getMinute());
  u8g.setPrintPos(34, 47);
  if (rtc.getSecond() % 2 == 1)
    u8g.print(":");
  else
    u8g.print(" ");
  u8g.setPrintPos(46, 50);
  if (rtc.getMinute() < 10)
  {
    u8g.print("0");
    u8g.print(rtc.getMinute());
  }
  else
    u8g.print(rtc.getMinute());
  u8g.setPrintPos(80, 47);
  if (rtc.getSecond() % 2 == 1)
    u8g.print(":");
  else
    u8g.print(" ");
  u8g.setPrintPos(90, 50);
  if (rtc.getSecond() < 10)
  {
    u8g.print("0");
    u8g.print(rtc.getSecond());
  }
  else
    u8g.print(rtc.getSecond());
}
void setRtcTime (byte _year, byte _month, byte _day, byte _week, byte _hour, byte _minute, byte _sec)
{
  //clear out all the registers
  rtc.initClock();
  rtc.setDate(_day, _week, _month, 0, _year);
  rtc.setTime(_hour, _minute, _sec);
}

String getRtcTimeString() {
  dateStr = rtc.formatDate(RTCC_DATE_US);
  dateStr += " ";
  dateStr += rtc.formatTime(RTCC_TIME_HMS);

  return dateStr;
}
